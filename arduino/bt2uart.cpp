#include <vector>
/* TODO: Include ArduinoJSON
#include ""
*/
#include "OBD2UART.h"



static const uint8_t valid_PIDs[128] = {
  0x04, //PID_ENGINE_LOAD 
  0x05, //PID_COOLANT_TEMP 
  0x06, //PID_SHORT_TERM_FUEL_TRIM_1 
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  0x62, //PID_ENGINE_TORQUE_PERCENTAGE 
  0x63 //PID_ENGINE_REF_TORQUE 
  }

static const char PID_names[128][32] = {
  "PID_ENGINE_LOAD",
  "PID_COOLANT_TEMP",
  "PID_SHORT_TERM_FUEL_TRIM_1",
  "PID_LONG_TERM_FUEL_TRIM_1",
  "PID_SHORT_TERM_FUEL_TRIM_2",
  "PID_LONG_TERM_FUEL_TRIM_2",
  "PID_FUEL_PRESSURE",
  "PID_INTAKE_MAP",
  "PID_RPM",
  "PID_SPEED",
  "PID_TIMING_ADVANCE",
  "PID_INTAKE_TEMP",
  "PID_MAF_FLOW",
  "PID_THROTTLE",
  "PID_AUX_INPUT",
  "PID_RUNTIME",
  "PID_DISTANCE_WITH_MIL",
  "PID_COMMANDED_EGR",
  "PID_EGR_ERROR",
  "PID_COMMANDED_EVAPORATIVE_PURGE",
  "PID_FUEL_LEVEL",
  "PID_WARMS_UPS",
  "PID_DISTANCE",
  "PID_EVAP_SYS_VAPOR_PRESSURE",
  "PID_BAROMETRIC",
  "PID_CATALYST_TEMP_B1S1",
  "PID_CATALYST_TEMP_B2S1",
  "PID_CATALYST_TEMP_B1S2",
  "PID_CATALYST_TEMP_B2S2",
  "PID_CONTROL_MODULE_VOLTAGE",
  "PID_ABSOLUTE_ENGINE_LOAD",
  "PID_AIR_FUEL_EQUIV_RATIO",
  "PID_RELATIVE_THROTTLE_POS",
  "PID_AMBIENT_TEMP",
  "PID_ABSOLUTE_THROTTLE_POS_B",
  "PID_ABSOLUTE_THROTTLE_POS_C",
  "PID_ACC_PEDAL_POS_D",
  "PID_ACC_PEDAL_POS_E",
  "PID_ACC_PEDAL_POS_F",
  "PID_COMMANDED_THROTTLE_ACTUATOR",
  "PID_TIME_WITH_MIL",
  "PID_TIME_SINCE_CODES_CLEARED",
  "PID_ETHANOL_FUEL",
  "PID_FUEL_RAIL_PRESSURE",
  "PID_HYBRID_BATTERY_PERCENTAGE",
  "PID_ENGINE_OIL_TEMP",
  "PID_FUEL_INJECTION_TIMING",
  "PID_ENGINE_FUEL_RATE",
  "PID_ENGINE_TORQUE_DEMANDED",
  "PID_ENGINE_TORQUE_PERCENTAGE",
  "PID_ENGINE_REF_TORQUE"
  }

uint8_t init_complete = 0;

void process_bluetooth_read_req(uint64_t upper_qword=0x00, uint64_t lower_qword=0x00) {
  if (upper_qword & (1 << 63) || !init_complete) {
    return;  //This is a Write request and not a read request. Something went wrong if this line triggers.
  }
  
  std::vector<uint8_t> uart_requests;


  //Process lower qword
  uint64_t mask = 1;
  for (int i = 0; i < 64; ++i) {
    if (i > 55) break; //Currently only 55 valid PIDs and I haven't null'd the empty parts of the array.
    if (lower_qword & mask)  uart_requests.push_back(valid_PIDs[i]);
    mask << mask << 1;
  }
  //Process upper qword
  /* currently unused; room for expansion
  mask = 1;
  for (int i = 0; i < 64; ++i) {
    if (lower_qword & mask)  uart_requests.push_back(valid_PIDs[i]);
    mask << mask << 1;
  }
  */
}
